## meta-petitboot/conf/distro/petitroot.conf
```bitbake
DISTRO = "petitroot"
DISTRO_NAME = "Petitroot (Distro customized for petitboot)"
DISTRO_VERSION = "1.0"

DISTRO_FEATURES_OPTED_OUT = "\
	3g \
	alsa \
	bluetooth \
	debuginfod \
	gobject-introspection-data \
	multiarch \
	nfc \
	opengl \
	pulseaudio \
	vulkan \
	wayland \
	x11 \
"

FULL_OPTIMIZATION = "-Os"
INIT_MANAGER ?= "sysvinit"

# Just in case someone overrides INIT_MANAGER
SYSTEMD_DEFAULT_TARGET = "multi-user.target"
```

## meta-powernv/conf/machine/include/powernv.inc
```bitbake
SOC_FAMILY = "powernv"

require conf/machine/include/soc-family.inc
require conf/machine/include/powerpc/arch-powerpc64.inc

DEFAULTTUNE = "powerpc64le"

PREFERRED_PROVIDER_virtual/bootloader ?= "skiboot"
EXTRA_IMAGEDEPENDS += "virtual/bootloader"
SKIBOOT_IMAGETYPES = "lid lid.xz"

PREFERRED_PROVIDER_virtual/kernel ?= "linux-openpower"
KERNEL_IMAGETYPE = "zImage.epapr"
INITRAMFS_FSTYPES = "cpio.xz"

PREFERRED_RPROVIDER_virtual-kexec = "kexec-lite"
```

## meta-powernv/conf/machine/include/qemuboot-powernv.inc
```bitbake
IMAGE_CLASSES += "qemuboot"

QB_SYSTEM_NAME = "qemu-system-ppc64"
QB_MACHINE = "-machine powernv"
QB_MEM = "-m 4096"
QB_DEFAULT_BIOS = "skiboot.lid"
QB_DEFAULT_FSTYPE = "cpio.xz"
QB_NETWORK_DEVICE = "-device e1000e,netdev=net0,mac=@MAC@"
```

## meta-powernv/conf/machine/powernv.conf
```bitbake
#@TYPE: Machine
#@NAME: Generic PowerNV (Non-Virtualized) machine
#@DESCRIPTION: Machine configuration for Power systems without a hypervisor

require conf/machine/include/powernv.inc
require conf/machine/include/qemuboot-powernv.inc

INITRAMFS_IMAGE ?= "petitboot-image"
INITRAMFS_MAXSIZE = "240000"
INITRAMFS_IMAGE_BUNDLE = "1"

PETITBOOT_GETTY_PORT = "hvc* tty0 ttyS*"
SERIAL_CONSOLES = ""
USE_VT = "0"

MACHINE_ESSENTIAL_EXTRA_RRECOMMENDS += "\
    kernel-modules \
    linux-firmware-bnx2x \
    linux-firmware-cxgb4 \
"

# Bundled petitboot initramfs
QB_KERNEL_ROOT = ""
QB_DEFAULT_FSTYPE = "none"
```
